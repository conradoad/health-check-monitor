## sdkconfig.defaults
```kconfig
# ESP8266_RTOS_SDK Configuration
# For SONOFF MINI ESP8266 based device

# Serial flasher config
CONFIG_ESPTOOLPY_FLASHSIZE_1MB=y
CONFIG_ESPTOOLPY_FLASHSIZE="1MB"
CONFIG_ESPTOOLPY_FLASHFREQ_40M=y
CONFIG_ESPTOOLPY_FLASHMODE_DIO=y

# Partition Table
CONFIG_PARTITION_TABLE_CUSTOM=y
CONFIG_PARTITION_TABLE_CUSTOM_FILENAME="partitions.csv"

# WiFi Configuration
CONFIG_ESP8266_WIFI_STATIC_RX_BUFFER_NUM=10
CONFIG_ESP8266_WIFI_DYNAMIC_RX_BUFFER_NUM=32
CONFIG_ESP8266_WIFI_STATIC_TX_BUFFER_NUM=16
CONFIG_ESP8266_WIFI_DYNAMIC_TX_BUFFER_NUM=16

# Network Configuration
CONFIG_LWIP_SO_RCVBUF=y
CONFIG_LWIP_SO_REUSE=y
CONFIG_LWIP_SO_REUSE_RXTOALL=y
CONFIG_LWIP_NETIF_LOOPBACK=y
CONFIG_LWIP_LOOPBACK_MAX_PBUFS=1

# HTTP Server Configuration
CONFIG_HTTPD_MAX_REQ_HDR_LEN=1024
CONFIG_HTTPD_MAX_URI_LEN=512

# FreeRTOS
CONFIG_FREERTOS_HZ=100
CONFIG_FREERTOS_UNICORE=y

# NVS
CONFIG_NVS_ENCRYPTION=n

# System
CONFIG_NEWLIB_STDOUT_LINE_ENDING_CRLF=y
CONFIG_NEWLIB_STDIN_LINE_ENDING_CR=y

# Log Configuration
CONFIG_LOG_DEFAULT_LEVEL_INFO=y
CONFIG_LOG_DEFAULT_LEVEL=3

# Crystal frequency
CONFIG_ESP8266_XTAL_FREQ_26=y
CONFIG_ESP8266_XTAL_FREQ=26
```
